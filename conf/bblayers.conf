## conf/bblayers.conf
```bitbake
# POKY_BBLAYERS_CONF_VERSION is increased each time build/conf/bblayers.conf
# changes incompatibly
POKY_BBLAYERS_CONF_VERSION = "2"

BBPATH = "${TOPDIR}"
BBFILES ?= ""

BBLAYERS ?= " \
  /data/users/cooper/pi/layers/poky/meta \
  /data/users/cooper/pi/layers/poky/meta-poky \
  /data/users/cooper/pi/layers/poky/meta-yocto-bsp \
  /data/users/cooper/pi/layers/meta-openembedded/meta-filesystems \
  /data/users/cooper/pi/layers/meta-openembedded/meta-oe \
  /data/users/cooper/pi/layers/meta-openembedded/meta-multimedia \
  /data/users/cooper/pi/layers/meta-openembedded/meta-networking \
  /data/users/cooper/pi/layers/meta-openembedded/meta-python \
  /data/users/cooper/pi/layers/meta-raspberrypi \
  /data/users/cooper/pi/layers/meta-virtualization \
  "
```
